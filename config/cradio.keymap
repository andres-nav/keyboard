// Copyright @filterpaper
// SPDX-License-Identifier: MIT

#include <behaviors.dtsi>
#include <dt-bindings/zmk/bt.h>
#include <dt-bindings/zmk/keys.h>
#include <dt-bindings/zmk/outputs.h>

#define CMK 1
#define NUM 2
#define SYM 3
#define FNC 4

#define TAPPING_TERM 240
#define QUICK_TAP_MS 140 // TAPPING_TERM - 100
#define SHIFT_TAP_MS 160 // TAPPING_TERM - 80
#define COMBO_TAP_MS 340 // TAPPING_TERM + 100

&lt {
    flavor          = "hold-preferred";
    tapping-term-ms = <TAPPING_TERM>;
    quick-tap-ms    = <QUICK_TAP_MS>;
};

&mt {
    flavor          = "tap-preferred";
    tapping-term-ms = <TAPPING_TERM>;
    quick-tap-ms    = <QUICK_TAP_MS>;
};

&caps_word {
    continue-list = <UNDER MINUS BSPC LSHFT RSHFT LS(SPACE) RS(SPACE)>;
};



#define HOLD_TAP(name, ht_flavor, tt_ms, rp_ms, hold_pos) \
name: name##_hold_tap {                                   \
    compatible                 = "zmk,behavior-hold-tap"; \
    #binding-cells             = <2>;                     \
    flavor                     = #ht_flavor;              \
    quick-tap-ms               = <QUICK_TAP_MS>;          \
    tapping-term-ms            = <tt_ms>;                 \
    require-prior-idle-ms      = <rp_ms>;                 \
    hold-trigger-key-positions = <hold_pos>;              \
    bindings                   = <&kp>, <&kp>;            \
};
#define L_SHIFT 13
#define R_SHIFT 16
#define L_KEYS 0 1 2 3 4 10 11 12 13 14 20 21 22 23 24 30 31 32 33
#define R_KEYS 5 6 7 8 9 15 16 17 18 19 25 26 27 28 29 30 31 32 33

/ {
    behaviors {
        // Clipboard shortcuts
        HOLD_TAP(ht, tap-preferred, TAPPING_TERM, QUICK_TAP_MS, 33)
        // Positional hold-tap for Shift
        HOLD_TAP(lst, balanced, SHIFT_TAP_MS, 0, R_KEYS)
        HOLD_TAP(rst, balanced, SHIFT_TAP_MS, 0, L_KEYS)
        // Positional hold-tap for non-Shift modifiers
        HOLD_TAP(lmt, tap-preferred, TAPPING_TERM, QUICK_TAP_MS, L_SHIFT R_KEYS)
        HOLD_TAP(rmt, tap-preferred, TAPPING_TERM, QUICK_TAP_MS, R_SHIFT L_KEYS)
    };
};



#define COMBO(name, kp, pos)               \
combo_##name {                             \
    timeout-ms            = <30>;          \
    require-prior-idle-ms = <COMBO_TAP_MS>;\
    bindings              = <kp>;          \
    key-positions         = <pos>;         \
    layers                = <0 1>;         \
};
/* Key positions
 0  1  2  3  4   5  6  7  8  9
10 11 12 13 14  15 16 17 18 19
20 21 22 23 24  25 26 27 28 29
         30 31  32 33 */
/ {
    combos {
        compatible = "zmk,combos";
        // invoke macros
        COMBO(vim_q,  &vim_q,   0  1)
        COMBO(vim_s,  &vim_s,  20 21)
        COMBO(dir_up, &dir_up, 28 29)
        // media keys
        COMBO(vol_up, &kp C_VOL_UP,  9 19)
        COMBO(vol_dn, &kp C_VOL_DN, 19 29)
        // navigation
        COMBO(arr_up, &kp UARW, 17 27)
        COMBO(arr_dn, &kp DARW, 16 26)
        COMBO(arr_lt, &kp LARW, 15 25)
        COMBO(arr_rt, &kp RARW, 18 28)
        // shortcuts
        COMBO(nav_up, &kp LS(LA(UARW)),  27 28)
        COMBO(nav_dn, &kp LS(LA(DARW)),  26 27)
        COMBO(sg_spc, &kp LS(LG(SPACE)), 22 23)
        // layer toggle
        COMBO(numb,   &tog NUM, 25 26 33)
    };
};



#define MACRO(name, keys)                 \
name: name##_macro {                      \
    compatible     = "zmk,behavior-macro";\
    #binding-cells = <0>;                 \
    tap-ms         = <1>;                 \
    wait-ms        = <1>;                 \
    bindings       = <keys>;              \
};

/ {
    macros {
        MACRO(vim_q,  &kp COLON &kp Q &kp EXCL)
        MACRO(vim_s,  &kp COLON &kp X)
        MACRO(dir_up, &kp DOT &kp DOT &kp FSLH)
        MACRO(bt_0,   &bt BT_SEL 0 &bt BT_DISC 1)
        MACRO(bt_1,   &bt BT_SEL 1 &bt BT_DISC 0)
        MACRO(bt_2,   &bt BT_SEL 2 &bt BT_DISC 0)
    };
};



#define Z_SLEEP  &kp LA(LG(C_PWR))
#define Z_SSAVE  &kp LC(LA(LS(LG(S))))
#define NAV_UP   &kp LS(LA(UARW))
#define NAV_DN   &kp LS(LA(DARW))
#define ALT_BSP  &kp LA(BSPC)
#define ________ &trans

#define HRML(k1,k2,k3,k4) &lmt LCTRL k1  &lmt LALT k2  &lmt LGUI k3  &lst LSHFT k4
#define HRMR(k1,k2,k3,k4) &rst RSHFT k1  &rmt RGUI k2  &rmt RALT k3  &rmt RCTRL k4
#define HT(k1,k2,k3,k4)   &ht LG(V) k1   &ht LG(C) k2  &ht LG(X) k3  &ht LG(Z) k4

#define SYM_TAB  &lt SYM TAB
#define LCA_ENT  &mt LC(LALT) ENTER
#define SFT_SPC  &mt RSHFT SPACE
#define NUM_BSP  &lt NUM BSPC

/ {
    keymap {
        compatible = "zmk,keymap";
        BASE_layer {
            bindings = <
        //╭──────────┬──────────┬──────────┬──────────┬──────────╮   ╭──────────┬──────────┬──────────┬──────────┬──────────╮
        //│  Q       │  W       │  E       │  R       │  T       │   │  Y       │  U       │  I       │  O       │  P       │
            &kp Q      &kp W      &kp E      &kp R      &kp T          &kp Y      &kp U      &kp I      &kp O      &kp P
        //├──────────┼──────────┼──────────┼──────────┼──────────┤   ├──────────┼──────────┼──────────┼──────────┼──────────┤
        //│  A       │  S       │  D       │  F       │  G       │   │  H       │  J       │  K       │  L       │ ' "      │
           HRML(A,         S,         D,         F)     &kp G          &kp H     HRMR(J,         K,         L,        SQT)
        //├──────────┼──────────┼──────────┼──────────┼──────────┤   ├──────────┼──────────┼──────────┼──────────┼──────────┤
        //│  Z       │  X       │  C       │  V       │  B       │   │  N       │  M       │ , <      │ . >      │ / ?      │
            &kp Z      &kp X      &kp C      &kp V      &kp B          &kp N       HT(M,      COMMA,       DOT,      FSLH)
        //╰──────────┴──────────┴──────────┼──────────┼──────────┤   ├──────────┼──────────┼──────────┴──────────┴──────────╯
                                             SYM_TAB    LCA_ENT        SFT_SPC    NUM_BSP
        //                                 ╰──────────┴──────────╯   ╰──────────┴──────────╯
            >;
        };
        CMK_layer {
            bindings = <
        //╭──────────┬──────────┬──────────┬──────────┬──────────╮   ╭──────────┬──────────┬──────────┬──────────┬──────────╮
        //│  Q       │  W       │  F       │  P       │  G       │   │  J       │  L       │  U       │  Y       │ ' "      │
            &kp Q      &kp W      &kp F      &kp P      &kp G          &kp J      &kp L      &kp U      &kp Y      &kp SQT
        //├──────────┼──────────┼──────────┼──────────┼──────────┤   ├──────────┼──────────┼──────────┼──────────┼──────────┤
        //│  A       │  R       │  S       │  T       │  D       │   │  H       │  N       │  E       │  I       │  O       │
           HRML(A,         R,         S,         T)     &kp D          &kp H     HRMR(N,         E,         I,         O)
        //├──────────┼──────────┼──────────┼──────────┼──────────┤   ├──────────┼──────────┼──────────┼──────────┼──────────┤
        //│  Z       │  X       │  C       │  V       │  B       │   │  N       │  M       │ , <      │ . >      │ / ?      │
            &kp Z      &kp X      &kp C      &kp V      &kp B          &kp K       HT(M,      COMMA,       DOT,      FSLH)
        //╰──────────┴──────────┴──────────┼──────────┼──────────┤   ├──────────┼──────────┼──────────┴──────────┴──────────╯
                                             ________   ________       ________   ________
        //                                 ╰──────────┴──────────╯   ╰──────────┴──────────╯
            >;
        };
        NUM_layer {
            bindings = <
        //╭──────────┬──────────┬──────────┬──────────┬──────────╮   ╭──────────┬──────────┬──────────┬──────────┬──────────╮
        //│ INSERT   │  1       │  2       │  3       │ VOL UP   │   │ HOME     │ PAGE DN  │ PAGE UP  │ END      │  :       │
            &kp INS    &kp N1     &kp N2     &kp N3    &kp C_VOL_UP    &kp HOME   &kp PG_DN  &kp PG_UP  &kp END    &kp COLON
        //├──────────┼──────────┼──────────┼──────────┼──────────┤   ├──────────┼──────────┼──────────┼──────────┼──────────┤
        //│ CAPS     │  4       │  5       │  6       │ VOL DN   │   │ LEFT     │ DOWN     │ UP       │ RIGHT    │  ;       │
           &caps_word  &kp N4     &kp N5     &kp N6    &kp C_VOL_DN    &kp LEFT   &kp DOWN   &kp UP     &kp RIGHT  &kp SEMI
        //├──────────┼──────────┼──────────┼──────────┼──────────┤   ├──────────┼──────────┼──────────┼──────────┼──────────┤
        //│ DELETE   │  7       │  8       │  9       │  0       │   │          │ SHFTA DN │ SHFTA UP │          │          │
            &kp DEL    &kp N7     &kp N8     &kp N9     &kp N0         ________   NAV_DN     NAV_UP     ________   ________
        //╰──────────┴──────────┴──────────┼──────────┼──────────┤   ├──────────┼──────────┼──────────┴──────────┴──────────╯
                                             &mo FNC    &kp ESC        ________   ________
        //                                 ╰──────────┴──────────╯   ╰──────────┴──────────╯
            >;
        };
        SYM_layer {
            bindings = <
        //╭──────────┬──────────┬──────────┬──────────┬──────────╮   ╭──────────┬──────────┬──────────┬──────────┬──────────╮
        //│          │  [       │  {       │  }       │          │   │  ^       │  (       │  )       │  ]       │  ~       │
            ________   &kp LBKT   &kp LBRC   &kp RBRC   ________       &kp CARET  &kp LPAR   &kp RPAR   &kp RBKT   &kp TILDE
        //├──────────┼──────────┼──────────┼──────────┼──────────┤   ├──────────┼──────────┼──────────┼──────────┼──────────┤
        //│  !       │  @       │  #       │  $       │  %       │   │  *       │  -       │  =       │  \       │  `       │
            &kp EXCL   &kp AT     &kp HASH   &kp DLLR   &kp PRCNT      &kp ASTRK  &kp MINUS  &kp EQUAL  &kp BSLH   &kp GRAVE
        //├──────────┼──────────┼──────────┼──────────┼──────────┤   ├──────────┼──────────┼──────────┼──────────┼──────────┤
        //│          │          │  <       │  >       │          │   │  &       │  _       │  +       │  │       │          │
            ________   ________   &kp LT     &kp GT     ________       &kp AMPS   &kp UNDER  &kp PLUS   &kp PIPE   ________
        //╰──────────┴──────────┴──────────┼──────────┼──────────┤   ├──────────┼──────────┼──────────┴──────────┴──────────╯
                                             ________   ________       ________   ALT_BSP
        //                                 ╰──────────┴──────────╯   ╰──────────┴──────────╯
            >;
        };
        FNC_layer {
            bindings = <
        //╭──────────┬──────────┬──────────┬──────────┬──────────╮   ╭──────────┬──────────┬──────────┬──────────┬──────────╮
        //│ RESET    │          │          │          │PROFILE 0 │   │          │          │          │          │ COLEMAK  │
           &sys_reset  ________   ________   ________   &bt_0        &out OUT_BLE ________   ________   ________   &tog CMK
        //├──────────┼──────────┼──────────┼──────────┼──────────┤   ├──────────┼──────────┼──────────┼──────────┼──────────┤
        //│BOOTLOADER│          │          │          │PROFILE 1 │   │          │          │          │          │BOOTLOADER│
          &bootloader  ________   ________   ________   &bt_1        &out OUT_USB ________   ________   ________  &bootloader
        //├──────────┼──────────┼──────────┼──────────┼──────────┤   ├──────────┼──────────┼──────────┼──────────┼──────────┤
        //│ SLEEP    │          │          │CLEAR PROF│PROFILE 2 │   │          │          │          │          │ SSAVE    │
            Z_SLEEP    ________   ________  &bt BT_CLR  &bt_2         &kp GLOBE  ________   ________   ________   Z_SSAVE
        //╰──────────┴──────────┴──────────┼──────────┼──────────┤   ├──────────┼──────────┼──────────┴──────────┴──────────╯
                                             ________   ________       ________   ________
        //                                 ╰──────────┴──────────╯   ╰──────────┴──────────╯
            >;
        };
    };
};
